## boards/arm/pca63539_nrf52832/Kconfig.board
```kconfig
# nRF52 DK NRF52832 board configuration

# Copyright (c) 2016 Nordic Semiconductor ASA
# SPDX-License-Identifier: Apache-2.0

config BOARD_PCA63539_NRF52832
	bool "pca63539_nrf52832 balancing robot shield"
	depends on SOC_NRF52832_QFAA
```

## boards/arm/pca63539_nrf52832/Kconfig.defconfig
```kconfig
# nRF52 DK NRF52832 board configuration

# Copyright (c) 2016 Nordic Semiconductor ASA
# SPDX-License-Identifier: Apache-2.0

if BOARD_PCA63539_NRF52832

config BOARD
	default "pca63539_nrf52832"

config BT_CTLR
	default BT

endif # BOARD_PCA63539_NRF52832
```

## boards/arm/pca63539_nrf52832/pca63539_nrf52832_defconfig
```kconfig
# SPDX-License-Identifier: Apache-2.0

CONFIG_SOC_SERIES_NRF52X=y
CONFIG_SOC_NRF52832_QFAA=y

# Enable MPU
CONFIG_ARM_MPU=y

# Enable hardware stack protection
CONFIG_HW_STACK_PROTECTION=y

# enable GPIO
CONFIG_GPIO=y

# enable uart driver
CONFIG_SERIAL=y

# additional board options
CONFIG_GPIO_AS_PINRESET=y

# Disable external 32k clock source
CONFIG_CLOCK_CONTROL_NRF_K32SRC_RC=y

# Enable gpio quadrature decoders
CONFIG_QDEC_GPIO=y

# Enable NRFX TWIS driver
CONFIG_NRFX_TWIS1=y
```

## drivers/qdec_gpio/Kconfig
```kconfig
menu "GPIO quadrature decoder"
config QDEC_GPIO
    bool "Enable gpio quadrature decoder"
    depends on GPIO
endmenu

module = QDEC_GPIO_DRIVER
module-str = qdec gpio driver
source "subsys/logging/Kconfig.template.log_config"
```
